## boards/board_cyd_2432s028/Kconfig.projbuild
```kconfig
menu "espAGC CYD board"

config ESPAGC_CYD_LCD_BL_GPIO
    int "LCD backlight GPIO"
    default 21
    range 0 39
    help
        GPIO driving the LCD backlight on the CYD. The canonical CYD
        (witnessmenow PINS.md) wires BL on GPIO21 active-high. Some less
        common revisions use GPIO27. If the screen stays dark on boot but
        `ST7789 ready ...` appears in the log, try toggling this between
        21 and 27.

config ESPAGC_CYD_LCD_BL_ACTIVE_LOW
    bool "LCD backlight is active-low"
    default n
    help
        When set, the firmware drives the backlight GPIO LOW to turn the
        panel on. Some CYD-C revisions wire the backlight through a PNP
        transistor and need active-low; the more common path is a direct
        active-high MOSFET. If toggling the BL GPIO didn't fix a dark
        screen, try toggling this.

config ESPAGC_CYD_LCD_BGR
    bool "Panel uses BGR pixel order (set if reds and blues are swapped)"
    default n
    help
        Toggles MADCTL bit 3 in the panel driver. CYD2USB ST7789 panels
        ship in both RGB- and BGR-filtered variants. Default is RGB; flip
        to y if reds and blues come out swapped on your unit.

config ESPAGC_CYD_LCD_INVERT
    bool "Send INVON during panel init (set if colors look correct only when inverted)"
    default n
    help
        ST7789 panels disagree about the polarity of their pixel data: most
        in this CYD line look right WITHOUT INVON (default). Symptom of
        wrong choice: green looks pink/magenta, white looks blue, an empty
        framebuffer is light not dark. Toggle and reflash if that's what
        you see.

endmenu
```

## components/channel_router/Kconfig.projbuild
```kconfig
menu "espAGC PROG ALARM watchdog"

config AGC_AUTO_RSET_AT_BOOT
    bool "Send a synthetic RSET ~1.5 s after boot to flush PROG ALARM"
    default y
    help
        Posts one DSKY_KEY_RSET keycode to channel 015 once the engine
        has run ~16 ChannelRoutine ticks (about 1.5 s wall-time). Used
        together with the peripheral_stub watchdog to keep the PROG
        ALARM lamp clear at idle. Disable to observe raw alarm
        behavior for debugging the underlying peripheral state.

config AGC_TRACE_KEYRUPT1
    bool "Trace KEYRUPT1 / NOVAC execution to UART"
    default n
    help
        Enable per-instruction UART logging while the engine is
        executing inside the KEYRUPT1 fixed-fixed window
        (RegZ in 04024..04046). Captures FBANK/BBANK/A/L/Q plus
        the two words at the address in Q (NOVAC's DCA target).
        Diagnostic for the keypress-dispatch bug documented in
        docs/NEXT_SESSION.md: on hardware, NOVAC schedules CHARIN
        with a bad CADR (077615). With this flag on, the trace
        will show whether the engine reads the correct 2CADR
        words at the moment of DCA. Leave off in production -
        emits ~16 log lines per keypress.

endmenu
```

## components/dsky_input/Kconfig.projbuild
```kconfig
menu "espAGC WiFi"

config ESPAGC_DISABLE_WIFI
    bool "Disable WiFi entirely (QEMU/headless builds)"
    default n
    help
        Skip dsky_input_start's WiFi initialisation. Use this for QEMU
        builds — the Espressif QEMU fork doesn't emulate the WiFi PHY,
        so esp_wifi_init asserts and panics. With WiFi off, the engine
        and channel_router still run; web DSKY just isn't available.

config ESPAGC_WIFI_MODE_STA
    bool "Connect to an existing WiFi network (STA mode)"
    depends on !ESPAGC_DISABLE_WIFI
    default y
    help
        When set, the dongle joins your home/office WiFi using the SSID
        and password configured below, and serves the DSKY web UI on
        whichever IP the AP assigned it. Falls back to SoftAP if those
        fields are empty.

config ESPAGC_WIFI_SSID
    string "WiFi SSID"
    depends on ESPAGC_WIFI_MODE_STA
    default ""
    help
        SSID to connect to. Leave empty to fall back to SoftAP "espAGC".

config ESPAGC_WIFI_PASSWORD
    string "WiFi password"
    depends on ESPAGC_WIFI_MODE_STA
    default ""
    help
        WPA/WPA2 passphrase for the SSID above.

endmenu
```

## components/touch_input/Kconfig.projbuild
```kconfig
# components/touch_input/Kconfig.projbuild
menu "espAGC touch driver"

choice ESPAGC_CYD_TOUCH
    prompt "CYD touch controller"
    default ESPAGC_CYD_TOUCH_XPT2046
    help
        Selects the touch driver for ESP32-2432S028 variants.
        Only XPT2046 is implemented in v1 — that's the canonical CYD's
        resistive touch (per witnessmenow PINS.md). GT911 / CST820
        capacitive variants are reserved for follow-up work.

config ESPAGC_CYD_TOUCH_XPT2046
    bool "XPT2046 (resistive — canonical CYD)"

config ESPAGC_CYD_TOUCH_GT911
    bool "GT911 (capacitive — alternate)"

config ESPAGC_CYD_TOUCH_CST820
    bool "CST820 (capacitive — alternate)"

endchoice

endmenu
```

## components/yaagc_socket/Kconfig.projbuild
```kconfig
menu "espAGC canonical yaAGC socket"

config AGC_YAAGC_NODE_PORT
    int "TCP port for yaAGC node listener"
    range 1024 65535
    default 19850
    help
        Port to bind on 0.0.0.0 for the canonical 4-byte yaAGC protocol.
        windows_yaagc_test.py picks per-pid ports above 19850 against
        upstream yaAGC.exe; using 19850 here keeps test scripts identical
        between the two builds. Under QEMU forward with
        -nic user,hostfwd=tcp::19850-:19850.

endmenu
```

## sdkconfig.defaults
```kconfig
CONFIG_IDF_TARGET="esp32"

# Flash (CYD-2432S028C: 4 MB DIO flash, no PSRAM)
CONFIG_ESPTOOLPY_FLASHSIZE_4MB=y
CONFIG_ESPTOOLPY_FLASHMODE_DIO=y
CONFIG_ESPTOOLPY_FLASHFREQ_40M=y

# Custom partition table
CONFIG_PARTITION_TABLE_CUSTOM=y
CONFIG_PARTITION_TABLE_CUSTOM_FILENAME="partitions.csv"

# Larger main task stack
CONFIG_ESP_MAIN_TASK_STACK_SIZE=8192

CONFIG_LOG_DEFAULT_LEVEL_INFO=y
CONFIG_COMPILER_OPTIMIZATION_PERF=y

# WiFi
CONFIG_ESP_WIFI_STATIC_RX_BUFFER_NUM=8
CONFIG_ESP_WIFI_DYNAMIC_RX_BUFFER_NUM=16

# Touch driver
CONFIG_ESPAGC_CYD_TOUCH_CST820=y

# Canonical SocketAPI listener port — engine I/O follows the same 4-byte
# protocol yaAGC.exe uses on Pi/Linux, so the device shows up as a
# drop-in yaAGC node to any peer that speaks it.
CONFIG_AGC_YAAGC_NODE_PORT=19850
```
